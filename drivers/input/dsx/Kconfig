## drivers/input/dsx/Kconfig
```kconfig
config TOUCHSCREEN_SYNAPTICS_DSX_I2C
	tristate "Synaptics DSX I2C touchscreen"
	depends on I2C
	help
	  Say Y here if you have a Synaptics DSX I2C touchscreen
	  connected to your system.

	  If unsure, say N.

	  To compile this driver as a module, choose M here: the
	  module will be called synaptics_dsx_i2c.

config TOUCHSCREEN_SYNAPTICS_DSX_RMI_DEV
	tristate "Synaptics DSX touchscreen char device"
	depends on TOUCHSCREEN_SYNAPTICS_DSX_I2C
	default y
	help
	  This enables support for direct register access for Synaptics DSX
	  touchscreens.

config TOUCHSCREEN_SYNAPTICS_DSX_TEST_REPORTING
	tristate "Synaptics DSX touchscreen test reporting"
	depends on TOUCHSCREEN_SYNAPTICS_DSX_I2C
	default y
	help
	  This enables support for test reporting for Synaptics DSX
	  touchscreens.

config TOUCHSCREEN_SYNAPTICS_DSX_FW_UPDATE
	tristate "Synaptics DSX touchscreen firmware update"
	depends on TOUCHSCREEN_SYNAPTICS_DSX_I2C
	default y
	help
	  This enables support for firmware update for Synaptics DSX
	  touchscreens.

config TOUCHSCREEN_SYNAPTICS_DSX_FN51
	tristate "Synaptics DSX touchscreen function $51"
	depends on TOUCHSCREEN_SYNAPTICS_DSX_I2C
	help
	  This enables support for function $51 for Synaptics DSX
	  touchscreens.
	  
config TOUCHSCREEN_DSX_SWIPE_CONTROL
	tristate "Synaptics DSX touchscreen function swipe control"
	depends on TOUCHSCREEN_SYNAPTICS_DSX_I2C
	help
	  This enables support for function swipe for Synaptics DSX
	  touchscreens.
```

## drivers/media/video/ms2r/Kconfig
```kconfig
config VIDEO_MS2R
	tristate "Fujitsu MS2R MIPI CSI-2 supporting camera driver"
	depends on I2C && VIDEO_V4L2 && MACH_M6X
	---help---
	  This driver supports Fujitsu MS2R ISP with sony IMX132 and IMX179 sensor
```

## drivers/modem/Kconfig
```kconfig
menuconfig MEIZU_MODEM
	bool "Meizu Mobile Modem Interface"
	default n
	---help---
	  Meizu Modem Interface Driver.

source "drivers/modem/xmm6x60/Kconfig"
source "drivers/modem/sc880xg/Kconfig"
```

## drivers/modem/sc880xg/Kconfig
```kconfig
config MEIZU_MODEM_TD
	bool "Meizu TD Mobile Modem Interface"
	depends on MEIZU_MODEM
	default n

config MODEM_SC8803G
	bool "TD SC8803G modem chip support"
	depends on MEIZU_MODEM_TD
	default n

config MODEM_SC8803G_CONTROL
	bool "TD SC8803G modem control interface"
	depends on MEIZU_MODEM_TD
	default n
```

## drivers/modem/xmm6x60/Kconfig
```kconfig
config MEIZU_MODEM_WD
	bool "Meizu WCDMA Mobile Modem Interface"
	depends on MEIZU_MODEM
	default n
	---help---
	  MEIZU Modem Interface Driver.

config UMTS_MODEM_XMM6160
	bool "modem chip : IFX XMM6160"
	depends on MEIZU_MODEM_WD
	default n

config UMTS_MODEM_XMM6260
	bool "modem chip : IFX XMM6260"
	depends on MEIZU_MODEM_WD
	default y

config UMTS_MODEM_XMM6262
	bool "modem chip : IFX XMM6262"
	depends on MEIZU_MODEM_WD
	default n

config LINK_DEVICE_HSIC
	bool "modem driver link device HSIC"
	depends on MEIZU_MODEM_WD
	default y

#config SIM_DETECT
	#bool "SIM_DETECT pin"
	#depends on MEIZU_MODEM_WD
	#default n
```

## kernel/autotest/Kconfig
```kconfig
config AUTOTEST
	bool "Enable kernel built-in autotest framework"
	default n
	help
	  This enable the entry to do some autotest for kernel, such as dump
	  the kernel log and so forth.

config AUTOTEST_SUSPEND
	bool "Run suspend test"
	default n
	select AUTOTEST
	depends on PM_TEST_SUSPEND
	help
	  Enable this option to test the system suspend.

	  If unsure, say N.

config AUTOTEST_SUSPEND_CYCLE
	int "Configure the suspend test cycle(in seconds)"
	range 1 3600
	depends on AUTOTEST_SUSPEND
	default 60
	help
	  Configure the suspend test cycle.

	  If unsure, keep default.

config AUTOTEST_SUSPEND_TIME
	int "Configure the auto suspend time(in seconds)"
	range 2 3600
	depends on AUTOTEST_SUSPEND
	default 10
	help
	  Configure the suspend time of suspend test.

	  If unsure, keep default.

config WAKEALARM_RTC
	string "RTC used to wakeup the suspended system"
	depends on AUTOTEST_SUSPEND
	default "rtc0"
	help
	  The RTC device that will be used to wake up the suspended
	  system.

config EXPORT_KIMAGE_PARTITION
	bool "Export the kernel image partition to user space"
	default n
	depends on AUTOTEST
	help
          This export the kernel image partition to user-space and allows
	  to flash it with a simple dd command.

          It is required by autotest for android.

	  If unsue, say NO.

config EXPORT_SERIALNO_INTERFACE
	bool "Export the /proc/serial_no interface to user-space"
	default n
	depends on AUTOTEST
	help
	  This allows to read/write the serial number of the USB port.

          It is required by autotest for android.

	  If unsue, say NO.
```

## sound/soc/audience/Kconfig
```kconfig
config AUDIENCE_ES305B
	tristate "ES305B Voice Processor Driver"
	default y
	help
	  Say Y here to enable es305b Voice Processor  support.
```

## sound/soc/nxp/Kconfig
```kconfig
config PA_TFA9887
	tristate "TFA9887 PA Voice Processor Driver"
	depends on (MACH_M6X)
	default y
	help
	  Enable PA TFA9887 config for m6x
```
